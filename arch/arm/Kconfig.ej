## arch/arm/mach-cxd4132/Kconfig
```kconfig
config ARCH_CXD4132BASED
	bool
	select CPU_V6K
	select IRQ_PER_CPU
	select ARCH_FLATMEM_ENABLE
	select ARCH_SPARSEMEM_ENABLE
	select SPARSEMEM_STATIC
	select ARCH_SELECT_MEMORY_MODEL
	select ZONE_DMA
	select HAVE_CLK
	select COMMON_CLKDEV
	select GENERIC_TIME
	select GENERIC_CLOCKEVENTS
	select ARM_AMBA
	select AUTO_IRQ_AFFINITY if SMP
	select EJ
	select ARCH_HAS_PM_SUSPEND_DISK
	select MACH_HAS_TRAP_INIT
	select HAVE_WATCHDOG
	select CLKDEV_LOOKUP

if ARCH_CXD4132BASED

menu "CXD4132 Options"

config MPCORE_GIC_INIT
	bool "Initialize Interrupt Controller"
	default n

config EXCLUSIVE_CACHE
	bool
	default n

config CACHE_PL310S
	bool "Enable the PL310 outer cache controller"
	default y
	select OUTER_CACHE
	select EXCLUSIVE_CACHE
	help
         This option enables the PL310 PrimeCell.

config CACHE_PL310_INIT
	bool "Initialize PL310"
	depends on CACHE_PL310S
	default n

config CACHE_PL310_EXCLUSIVE
	bool "PL310 exclusive mode"
	depends on CACHE_PL310_INIT
	default y

comment "Memory Layout"
config CXD4132_TEXT_OFFSET
	hex "Text offset of kernel"
	default 0x008000
	help
	  kernel will be compiled at 0xC000_0000 + TEXT_OFFSET

config MODULES_OFFSET
	hex "modules start address"
	default 0xbf000000

config PGTBL_AREA_ADDRESS
	hex "page table area virt address"
	default 0

comment "Memory config"

config CXD4132_DDR_RANK0_ABSENT
	bool "DDR RANK0 is not populated."
	default n

config CXD4132_DDR_ACCESS_DETECT
	bool "Detect DDR access during suspend sequence"
	default n
	depends on (PM && DEBUG_LL)

comment "Misc config"

config CXD4132_USE_DEVICE_SO
	bool "Enable the workaround by MT_DEVICE_SO"
	default y

config CXD4132_USE_MEMORY_UC
	bool "Type of uncached memory is MT_MEMORY_UC instead of MT_DEVICE"
	default n
	help
	  MT_MEMORY_UC is Uncacheable Normal Memory attribute.
	  MT_DEVICE is Shared Device attribute.

comment "Development support"

config QEMU
	bool "QEMU"
	select EJ_DO_NOT_FREE_INIT
	select CXD41XX_SIMPLE_LOADER
	select CXD41XX_SIMPLE_SUSPEND

source "arch/arm/mach-cxd4132/Kconfig.uart"
source "arch/arm/mach-cxd4132/Kconfig.ether"

endmenu

config CXD4132_GPIO
	bool "GPIO Driver"
	depends on OSAL_UDIF
	default y

config MACH_HAS_TRAP_INIT
	bool

config HAVE_WATCHDOG
	bool

endif
```

## arch/arm/mach-cxd4132/Kconfig.uart
```kconfig
choice
	prompt "UART Number for DEBUG_LL console"
	default CXD4132_DEBUG_UART0
config CXD4132_DEBUG_UART0
	bool "UART0"
config CXD4132_DEBUG_UART1
	bool "UART1"
config CXD4132_DEBUG_UART2
	bool "UART2"
endchoice

config CXD4132_DEBUG_UART_NO
	int
	default 0 if CXD4132_DEBUG_UART0
	default 1 if CXD4132_DEBUG_UART1
	default 2 if CXD4132_DEBUG_UART2
```

## arch/arm/mach-cxd90014/Kconfig
```kconfig
config ARCH_CXD90014BASED
	bool
	select CPU_V7
	select ARM_GIC
	select IRQ_PER_CPU
	select ARCH_FLATMEM_ENABLE
	select ARCH_SPARSEMEM_ENABLE
#	select SPARSEMEM_STATIC
	select ARCH_SELECT_MEMORY_MODEL
#	select ZONE_DMA
	select HAVE_CLK
	select COMMON_CLKDEV
	select GENERIC_TIME
	select GENERIC_CLOCKEVENTS
	select HAVE_SCHED_CLOCK
	select ARM_AMBA
	select AUTO_IRQ_AFFINITY if SMP
	select CLKDEV_LOOKUP
	select EJ
	select ARCH_HAS_PM_SUSPEND_DISK
	select MACH_HAS_TRAP_INIT
	select MIGHT_HAVE_PCI
	select HAVE_WATCHDOG

if ARCH_CXD90014BASED

menu "CXD90014 Options"

comment "Memory Layout"
config CXD90014_TEXT_OFFSET
	hex "Text offset of kernel"
	default 0x008000
	help
	  kernel will be compiled at 0x8000_0000 + TEXT_OFFSET

config TASK_MMAP_OFFSET
	hex "task mmap VM area"
	default 0
	help
	  The lower boundary address of the mmap VM area.
	  If this is set to 0, the address will be CONFIG_PAGE_OFFSET/2.

config CXD90014_DDR512MB
	bool "DDR 512MB"
	default n

comment "Misc config"
config CXD90014_ADRSCONV_RELAX
	bool "PHYS_TO_NONCACHE accepts VA"
	default y
	help
	  PHYS_TO_NONCACHE accepts physical address and virtual address.

config CXD90014_PCIE2_DMX
	bool
	depends on PCI && !QEMU
	default y
	help
	  Support for pcie2_dmx driver.

config CXD90014_NANDC
	bool
	depends on !QEMU
	default y
	help
	  kernel set config NAND Controller Register

config OVERCOMMIT_ALWAYS
	bool "Always overcommit memory"
	default y

config OOM_CALLBACK
	bool "Enable CALLBACKs if OOM Kill happens"
	default y
	help
	  Print something useful during OOM,
	  and then send SEGV to fall into EM.

config EJ_AMBA_VIRTUAL
	bool
	default y

config CXD90014_EXT_TIMER
	bool "Use TIMER IP for local timer"
	default y

comment "Development support"

config CXD90014_FPGA
	bool "FPGA board"
	default n
	select CXD90014_SIMPLE_LOADER
	select CXD90014_SIMPLE_SUSPEND

config QEMU
	bool "QEMU"
	select EJ_DO_NOT_FREE_INIT
	select CXD90014_SIMPLE_LOADER
	select CXD90014_SIMPLE_SUSPEND

config CXD90014_DDR_C2UNC
	bool "Changes cache attribute of normal memory to uncacheable"
	default y

config CXD90014_SIMPLE_LOADER
	bool
	default n

config CXD90014_SIMPLE_SUSPEND
	bool
	default n

config DEBUG_EARLY
	bool
	depends on DEBUG_LL
	default y

config SMP_COMMON_ENTRY
	bool "SMP COMMON Entry"
	depends on SMP || MPCORE_GIC_INIT
	default n
	help
	  If all CPU jumps to kernel entry point on reset, say Y.

source "arch/arm/mach-cxd90014/Kconfig.uart"
source "arch/arm/mach-cxd90014/Kconfig.ether"

endmenu

config MACH_HAS_TRAP_INIT
	bool

config HAVE_WATCHDOG
	bool

config ARM_DAP
	bool
	default y if !CXD90014_FPGA && !QEMU

endif
```

## arch/arm/mach-cxd90014/Kconfig.ether
```kconfig
config CXD90014_SMC911X_INT
	int "SMC911X: IRQ#"
	default 3

config CXD90014_SRAMC_CSMASK_ERRATA
	bool "SRAMC CS Mask ERRATA"
	default y
```

## arch/arm/mach-cxd90014/Kconfig.uart
```kconfig
choice
	prompt "UART Number for DEBUG_LL console"
	default CXD90014_DEBUG_UART0
config CXD90014_DEBUG_UART0
	bool "UART0"
config CXD90014_DEBUG_UART1
	bool "UART1"
config CXD90014_DEBUG_UART2
	bool "UART2"
endchoice

config CXD90014_DEBUG_UART_NO
	int
	default 0 if CXD90014_DEBUG_UART0
	default 1 if CXD90014_DEBUG_UART1
	default 2 if CXD90014_DEBUG_UART2

config CXD90014_UART_IO_INIT
	bool "Initialize UART I/O pin"
	depends on !CXD90014_FPGA
	default n
```

## arch/arm/mach-emxx/Kconfig
```kconfig
if ARCH_EMXX

menu "EMMA Mobile series Implementations"

choice
	prompt "EMMA Mobile Core Type"
	default MACH_EMEV

config MACH_EMEV
	bool "EMMA Mobile EV1/EV2"
	select CPU_V7

config MACH_EMGR
	bool "EMMA Mobile EV0"
	select CPU_V7
endchoice

choice
	prompt "EMMA Mobile Board Type"
	default EMEV_BOARD_EVA

config EMEV_BOARD_EVA
	bool "EMMA Mobile EV1/2 Evaluation board"
	depends on MACH_EMEV

config EMEV_KZM9D
	bool "KMC KZM-A9-Dual board"
	depends on MACH_EMEV

config EMGR_BOARD_EVA
	bool "EMMA Mobile EV0 Evaluation board"
	depends on MACH_EMGR
endchoice

if MACH_EMGR
choice
	prompt "EMMA Mobile EV0 Memory size"
	default EMGR_2G_MEM

config EMGR_2G_MEM
	bool "2G Bit"

config EMGR_1G_MEM
	bool "1G Bit"
endchoice
endif

config EMGR_TI_PMIC
	bool "TI power board support"
	depends on EMGR_BOARD_EVA

config EMXX_QR
	bool "Enable QR"
	default y

config EMXX_L310
	bool "ARM L2 cache Enable"
	default y
	select CACHE_L2X0
	select EMXX_L310_NORAM if MACH_EMGR

config EMXX_L310_NORAM
	bool
	depends on MACH_EMGR

if MACH_EMEV

choice
	prompt "L2 cache way-size"
	depends on EMXX_L310
	default EMXX_L310_8WAY

config EMXX_L310_8WAY
	bool "8way 32KByte"

config EMXX_L310_16WAY
	bool "16way 16KByte"
endchoice

endif

config EMXX_ANDROID
	bool "Use Android setting"

config EMXX_SPI0
	bool "SPI0 Driver support"
	default y

config EMXX_SPI_EXCL_SP0
	int "SP0 Exclusive control method (0:scheduling/1:interrupt disabled)"
	depends on EMXX_SPI0
	default "1"

config EMXX_SPI
	tristate "SPI Driver support (SPI1)"

config EMXX_PWM
	tristate "PWM Driver support"

config EMXX_DTV
	tristate "DTV Interface support"

config EMXX_DTV_BUFFERSIZE
	int "DMA buffer size (752-)[byte]"
	depends on EMXX_DTV
	default "8192"

config EMXX_PWC
	bool
	depends on EMXX_SPI0
	default y

config EMXX_EXTIO
	bool
	depends on (EMEV_BOARD_EVA || EMGR_BOARD_EVA) && I2C
	default y

config EMXX_LED
	bool
	depends on EMXX_PWC
	default y

config EMXX_PDMA
	tristate "Software interrupt support for PDMA"
	depends on MACH_EMGR
	default y

config EMXX_INTERDSP
	tristate "InterDSP support"
	default m

if MACH_EMEV
config EMXX_DMA_LCH0
	int "P2M/M2P DMA LCH0 device"
	default 7
	help
	   0:MMM    1:MSP_GDF  2:MSP_PB  3:CRP
	   6:UART0  7:UART1    8:UART2   9:UART3 10:SIO0  11:SIO1 
	   12:SIO2 13:SIO3    14:SIO4   15:SIO5

config EMXX_DMA_LCH1
	int "P2M/M2P DMA LCH1 device"
	default 0
	help
	   0:MMM    1:MSP_GDF  2:MSP_PB  3:CRP
	   6:UART0  7:UART1    8:UART2   9:UART3 10:SIO0  11:SIO1 
	   12:SIO2 13:SIO3    14:SIO4   15:SIO5

config EMXX_DMA_LCH2
	int "P2M/M2P DMA LCH2 device"
	default 1
	help
	   0:MMM    1:MSP_GDF  2:MSP_PB  3:CRP 
	   6:UART0  7:UART1    8:UART2   9:UART3 10:SIO0  11:SIO1 
	   12:SIO2 13:SIO3    14:SIO4   15:SIO5

config EMXX_DMA_LCH3
	int "P2M/M2P DMA LCH3 device"
	default 2
	help
	   0:MMM    1:MSP_GDF  2:MSP_PB  3:CRP
	   6:UART0  7:UART1    8:UART2   9:UART3 10:SIO0  11:SIO1 
	   12:SIO2 13:SIO3    14:SIO4   15:SIO5

config EMXX_DMA_LCH4
	int "P2M/M2P DMA LCH4 device"
	default 10
	help
	   0:MMM    1:MSP_GDF  2:MSP_PB  3:CRP
	   6:UART0  7:UART1    8:UART2   9:UART3 10:SIO0  11:SIO1 
	   12:SIO2 13:SIO3    14:SIO4   15:SIO5

config EMXX_DMA_LCH5
	int "P2M/M2P DMA LCH5 device"
	default 11
	help
	   0:MMM    1:MSP_GDF  2:MSP_PB  3:CRP
	   6:UART0  7:UART1    8:UART2   9:UART3 10:SIO0  11:SIO1 
	   12:SIO2 13:SIO3    14:SIO4   15:SIO5

config EMXX_DMA_LCH6
	int "P2M/M2P DMA LCH6 device"
	default 12
	help
	   0:MMM    1:MSP_GDF  2:MSP_PB  3:CRP
	   6:UART0  7:UART1    8:UART2   9:UART3 10:SIO0  11:SIO1 
	   12:SIO2 13:SIO3    14:SIO4   15:SIO5

config EMXX_DMA_LCH7
	int "P2M/M2P DMA LCH7 device"
	default 13
	help
	   0:MMM    1:MSP_GDF  2:MSP_PB  3:CRP
	   6:UART0  7:UART1    8:UART2   9:UART3 10:SIO0  11:SIO1 
	   12:SIO2 13:SIO3    14:SIO4   15:SIO5

config SNSC_EMXX_TIMER_IRQ_FLAGS
	bool "define extra irq flags for timer irq handler"
	depends on SNSC && ARCH_EMXX
	default n
	help
	   This config is used to pass extra irq flags to
	   emxx_timer_register_cb() routine i.e useful for
	   RT-testbed module.

endif

if MACH_EMGR
config EMXX_DMA_LCH0
	int "P2M/M2P DMA LCH0 device"
	default 7
	help
	   0:MMM    1:MSP_GDF  2:MSP_PB  4:UART4  5:UART5
	   6:UART0  7:UART1    8:UART2   9:UART3 10:SIO0  11:SIO1
	   12:SIO2 13:SIO3

config EMXX_DMA_LCH1
	int "P2M/M2P DMA LCH1 device"
	default 0
	help
	   0:MMM    1:MSP_GDF  2:MSP_PB  4:UART4  5:UART5
	   6:UART0  7:UART1    8:UART2   9:UART3 10:SIO0  11:SIO1
	   12:SIO2 13:SIO3

config EMXX_DMA_LCH2
	int "P2M/M2P DMA LCH2 device"
	default 1
	help
	   0:MMM    1:MSP_GDF  2:MSP_PB  4:UART4  5:UART5
	   6:UART0  7:UART1    8:UART2   9:UART3 10:SIO0  11:SIO1
	   12:SIO2 13:SIO3

config EMXX_DMA_LCH3
	int "P2M/M2P DMA LCH3 device"
	default 2
	help
	   0:MMM    1:MSP_GDF  2:MSP_PB  4:UART4  5:UART5
	   6:UART0  7:UART1    8:UART2   9:UART3 10:SIO0  11:SIO1
	   12:SIO2 13:SIO3

config EMXX_DMA_LCH4
	int "P2M/M2P DMA LCH4 device"
	default 10
	help
	   0:MMM    1:MSP_GDF  2:MSP_PB  4:UART4  5:UART5
	   6:UART0  7:UART1    8:UART2   9:UART3 10:SIO0  11:SIO1
	   12:SIO2 13:SIO3

config EMXX_DMA_LCH5
	int "P2M/M2P DMA LCH5 device"
	default 11
	help
	   0:MMM    1:MSP_GDF  2:MSP_PB  4:UART4  5:UART5
	   6:UART0  7:UART1    8:UART2   9:UART3 10:SIO0  11:SIO1
	   12:SIO2 13:SIO3

config EMXX_DMA_LCH6
	int "P2M/M2P DMA LCH6 device"
	default 12
	help
	   0:MMM    1:MSP_GDF  2:MSP_PB  4:UART4  5:UART5
	   6:UART0  7:UART1    8:UART2   9:UART3 10:SIO0  11:SIO1
	   12:SIO2 13:SIO3

config EMXX_DMA_LCH7
	int "P2M/M2P DMA LCH7 device"
	default 13
	help
	   0:MMM    1:MSP_GDF  2:MSP_PB  4:UART4  5:UART5
	   6:UART0  7:UART1    8:UART2   9:UART3 10:SIO0  11:SIO1
	   12:SIO2 13:SIO3
endif

config SNSC_EMXX_SCHED_CLOCK_USE_TG_TIMER
	bool "Use TG[0-5] any timer counter for sched_clock()"
	default n
	help
	   EMXX timer module(TIM), have [TG0-TG5].
	   TG[0-5] is configured to be driven by DIV_TIM_CLK (PLL3) at 5Mhz.

config SNSC_EMXX_SCHED_CLOCK_TG_TIMER
	int "Use TG timer [0-5]"
	depends on SNSC_EMXX_SCHED_CLOCK_USE_TG_TIMER
	default 0

config SNSC_EMXX_CHANGE_AVAILABLE_TIMER
	bool "Forcefully increase available timer for emxx"
	depends on SNSC && ARCH_EMXX
	default n
	help
	   This config is used to increase number of available
	   timers that will be used in rt-testbed module.

config SNSC_EMXX_MAX_AVAILABLE_TIMER
	int "Number of available timers"
	range 0 14
	depends on SNSC_EMXX_CHANGE_AVAILABLE_TIMER
	default 9
	help
	   The total number of timers available are 15.

endmenu

endif
```

## arch/arm/mach-ne1/Kconfig
```kconfig
menu "NaviEngine1 platform type"
        depends on ARCH_NE1

config MACH_NE1TB
        bool "Support NE1-TB platform"
	select CPU_V6K
	select ARM_ERRATA_484863 if CACHE_L2X0
	select SNSC_DISABLED_8250_UART_BUG_TXEN if SERIAL_8250
	default y
        help
          Include support for the NE1-TB platform.

config MACH_NE1DB
        bool "Support NE1-DB platform"
	default n
        help
          Include support for the NE1-DB platform.

menu "Device drivers for the NaviEngine1 embedded controllers"
#       depends on (MACH_NE1TB || MACH_NE1DB)

config NE1_GPIO
	bool
	default n

config NE1_USB
	bool "Support NE1 OHCI/EHCI USB driver"
	depends on PCI
	default n
	help
	  Include support for the NE1 OHCI/EHCI USB interface.

endmenu

menu "Device drivers for the NE1-xB on-board devices"
#       depends on (MACH_NE1TB || MACH_NE1DB)

endmenu

endmenu
```

## block/Kconfig.snsc
```kconfig
if BLOCK

menu "SNSC Configurations"

comment "SNSC related options"
	depends on SNSC

config SNSC_ROOTFS_NOATIME
        bool "Ability to specify noatime from kernel cmdline."
        depends on SNSC
        default y

config SNSC_REPLACE_LOCAL_IRQ_DISABLE_FOR_BLK_CPU_DONE
        bool "Use preempt_disable() for protecting blk_cpu_done list"
        depends on SNSC && PREEMPT_RT_FULL
        default n

endmenu

endif # BLOCK
```

## drivers/block/compswap/Kconfig
```kconfig
config COMPSWAP
	tristate "CompSwap device"
	depends on SWAP
	default y

if COMPSWAP

config COMPSWAP_LZO_COMPRESSION
	tristate "CompSwap LZO Plugin"
	default y
	select LZO_COMPRESS
	select LZO_DECOMPRESS

config COMPSWAP_MAJOR_NR
	int "Device major number"
	range 0 255
	default 0
	help
	  If you set 0, major number is automatically selected

endif # COMPSWAP
```

## drivers/tty/serial/Kconfig.snsc
```kconfig
config SNSC_VUART
	bool "UART multiplexing support"
	default n
	depends on SNSC
	help
	  UART multiplexing support
	  If "Y", register a virtual UART for multiplexing.
	  Four sub-configurations should be correctly set to support
	  this feature.

config SNSC_VUART_MAJOR_NUM
	int "VUART major number"
	range 0 255
	default 204
	depends on SNSC_VUART
	help
	  VUART major number.
  	  Please use an available number as major number.
  	  For instance,
  	  If 204 is set, virtual UART device major number will be 204.

config SNSC_VUART_MINOR_NUM
	int "VUART minor number"
	range 0 255
	default 240
	depends on SNSC_VUART
	help
	  VUART minor number.
	  Please use an available number as minor number.
	  For instance,
	  If 240 is set, virtual UART device minor number will be 240.

config SNSC_VUART_NR_UARTS
	int "VUART device number"
	range 0 255
	default 4
	depends on SNSC_VUART
	help
	  VUART device number.
	  Please set a correct device number.
	  For instance,
	  If 4 is set, 4 ports of virtual UART device will be registed.

config SNSC_VUART_CONSOLE
	string "VUART multiplexed console name"
	default "ttyAM0"
	depends on SNSC_VUART
	help
	  VUART multiplexing console name.
	  This configuration should be set exactly as which console
	  will be multiplexed.
	  For instance,
	  For most KZM9D boards, ttyS1 should be set.
```
