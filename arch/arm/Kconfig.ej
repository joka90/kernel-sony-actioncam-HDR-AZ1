## drivers/udif/Kconfig
```kconfig
#
# OSAL UDM configuration
#

menuconfig OSAL_UDIF
	tristate  "OSAL UDM Support"
	depends on !CXD4115_COMPAT
	default n
	help
	  "OS abstraction layer, for Unified Driver Module (I/F)"

if OSAL_UDIF

config OSAL_UDIF_THREAD
	bool "Registing drivers works on each kernel thread"
	default y

config OSAL_UDIF_BDEV_THREAD
	bool "Enable the thread for bdev request operation"
	default y

config OSAL_UDIF_ERROR_PRINT
	bool "Enable to print when error is detected"
	default y

endif
```

## drivers/usb/f_usb/Kconfig
```kconfig
#
# fusb_otg USB Controller Driver
#

comment "fusb_otg - USB Controller Driver"

config USB_FUSB_OTG
	bool 'fusb_otg USB OTG controller support'
	default y
	---help---
	  non
```

## drivers/usb/gcore/Kconfig
```kconfig
comment "USB OTG/Gadget Subsystem"

config USB_EVENT
	tristate 'USB Event'
	default n

config USB_EVENT_LOGGING
	int  'Logging Level (0: None / 1: Debug / 2: Verbose )'
	depends on USB_EVENT
	default "0"

config USB_OTG_CORE
	tristate 'USB OTG Core'
	depends on USB_EVENT
	default y

config USB_OTG_CORE_LOGGING
	int  'Logging Level (0: None / 1: Debug / 2: Verbose )'
	depends on USB_OTG_CORE
	default "0"

config USB_GADGET_CORE
	tristate 'USB Gadget Core'
	depends on USB_EVENT
	default y

config USB_GADGET_CORE_LOGGING
	int  'Logging Level (0: None / 1: Debug / 2: Verbose )'
	depends on USB_GADGET_CORE
	default "0"
```

## drivers/usb/htmd/Kconfig
```kconfig
comment "USB Host Test Mode Drivers"

config USB_HOST_TEST_MODE
	tristate 'USB Host Test Mode Support'
	depends on USB
	default m

config USB_HOST_TEST_MODE_LOGGING
	int  'Logging Level (0: None / 1: Debug / 2: Verbose )'
	depends on USB_HOST_TEST_MODE
	default "0"
```

## drivers/usb/storage/Kconfig.snsc
```kconfig
comment "SNSC related options"
	depends on SNSC

config SNSC_USB_STORAGE_USE_GFP_NOWAIT_OR_ATOMIC
	bool "Use GFP_NOWAIT or GFP_ATOMIC in a USB storage driver"
	depends on SNSC
	depends on USB_STORAGE
	help
	  To avoid a memory starvation with swap areas on a USB HDD,
	  use GFP_NOWAIT or GFP_ATOMIC instead of GFP_NOIO
	  in the USB storage driver.
```

## fs/squashfs/Kconfig.snsc
```kconfig
#
# SNSC related configurations
#

config SNSC_FS_SQUASHFS_SB_MIN_BLOCKSIZE
	bool "Change block size for sb_min_blocksize()"
	depends on SNSC
	depends on SQUASHFS
	default n

config SNSC_FS_SQUASHFS_SB_MIN_BLOCKSIZE_VALUE
	int "block size (in bytes) for sb_min_blocksize()"
	depends on SNSC_FS_SQUASHFS_SB_MIN_BLOCKSIZE
	default 4096
```

## init/Kconfig.snsc
```kconfig
#
# SNSC related configurations
#

config SNSC_NLVER_CUSTOMVER_ENABLE
	bool 'Use custom kernel version'
  	depends on SNSC

config SNSC_NLVER_CUSTOMVER
   	string 'Custom kernel version'
   	depends on SNSC_NLVER_CUSTOMVER_ENABLE
   	depends on SNSC

config SNSC_NLVER_REPOSITORYVERSION_AUTO
  	bool 'Embed git/arch repository revision'
   	depends on SNSC

config SNSC_NLVER_NBLVER
   	bool 'Add support of NBL version'
   	depends on SNSC
   	depends on SNSC_NBLARGS
  	default y if ARM
   	default n

config SNSC_BOOT_FORMAT
	bool "Select kernel image format"
   	depends on SNSC
   	default n

config SNSC_BOOT_BIN
   	bool "Raw Binary"
   	depends on SNSC_BOOT_FORMAT
   	default n

config SNSC_BOOT_BIN_GZ
   	bool "Gzipped Raw Binary"
   	depends on SNSC_BOOT_FORMAT
   	default n

config SNSC_BOOT_ELF
   	bool "Stripped ELF"
   	depends on SNSC_BOOT_FORMAT
   	default n

config SNSC_BOOT_ELF_GZ
   	bool "Gzipped & Stripped ELF"
   	depends on SNSC_BOOT_FORMAT
   	default n

config SNSC_INITRD_MNTPT
	string 'Initrd mount point after boot.'
	depends on SNSC
	depends on BLK_DEV_INITRD
	default "/initrd"

config SNSC_ROOTDEV_AFTER_INITRD
	bool 'Use root filesystem on block device insmod by initrd'
	depends on SNSC
	depends on BLK_DEV_INITRD

config SNSC_DEFERRED_INITCALLS
	bool 'Support for deferred initcalls'
	depends on SNSC
	depends on ARM
	default n

config SNSC_DEFERRED_INITCALLS_SCSI
	bool 'Enable deferred initcalls for SCSI'
	depends on SNSC_DEFERRED_INITCALLS
	depends on SCSI
	default n

config SNSC_DEFERRED_INITCALLS_GROUP_BLK_DEV_SD
	int 'Group number for SCSI disk driver (0-31)'
	depends on SNSC_DEFERRED_INITCALLS_SCSI
	depends on BLK_DEV_SD
	default 16

config SNSC_DEFERRED_INITCALLS_USB
	bool 'Enable deferred initcalls for USB'
	depends on SNSC_DEFERRED_INITCALLS
	depends on USB
	default n

config SNSC_DEFERRED_INITCALLS_GROUP_USB_HCD
	int 'Group number for USB Host Controller drivers (0-31)'
	depends on SNSC_DEFERRED_INITCALLS_USB
	depends on USB_EHCI_HCD || USB_OHCI_HCD
	default 16

config SNSC_DEFERRED_INITCALLS_GROUP_USB_STORAGE
	int 'Group number for USB Storage driver (0-31)'
	depends on SNSC_DEFERRED_INITCALLS_USB
	depends on USB_STORAGE
	default 16

config SNSC_DEFERRED_INITCALLS_GROUP_USB_VIDEO_CLASS
	int 'Group number for USB Video Class driver (0-31)'
	depends on SNSC_DEFERRED_INITCALLS_USB
	depends on USB_VIDEO_CLASS
	default 16

config SNSC_NULL_CONSOLE
	bool 'Support for NULL console'
  	depends on SNSC

config SNSC_LOOPBACK_SCHED_OPTION
       bool 'Set scheduler policy/priority for loopback device'
       depends on SNSC
       depends on BLK_DEV_LOOP
       select SNSC_SET_THREAD_PRIORITY

config SNSC_LOOPBACK_SCHED_POLICY
       int 'Scheduler Policy(0=NORMAL, 1=FIFO, 2=RR)'
       depends on SNSC
       depends on SNSC_LOOPBACK_SCHED_OPTION
       default 2

config SNSC_LOOPBACK_SCHED_PRIORITY
       int 'Scheduler Priority(NORMAL:-20..19, FIFO/RR:1..99)'
       depends on SNSC
       depends on SNSC_LOOPBACK_SCHED_OPTION
       default 99

config SNSC_KSWAPD_SCHED_OPTION
       bool 'Set scheduler policy/priority for kswapd'
       depends on SNSC
       select SNSC_SET_THREAD_PRIORITY

config SNSC_KSWAPD_SCHED_POLICY
       int 'Scheduler Policy(0=NORMAL, 1=FIFO, 2=RR)'
       depends on SNSC
       depends on SNSC_KSWAPD_SCHED_OPTION
       default 2

config SNSC_KSWAPD_SCHED_PRIORITY
       int 'Scheduler Priority(NORMAL:-20..19, FIFO/RR:1..99)'
       depends on SNSC
       depends on SNSC_KSWAPD_SCHED_OPTION
       default 99

config SNSC_KSOFTIRQD_SCHED_OPTION
       bool 'Set scheduler policy/priority for ksoftirqd'
       depends on SNSC
       select SNSC_SET_THREAD_PRIORITY

config SNSC_KSOFTIRQD_SCHED_POLICY
       int 'Scheduler Policy(0=NORMAL, 1=FIFO, 2=RR)'
       depends on SNSC
       depends on SNSC_KSOFTIRQD_SCHED_OPTION
       default 2

config SNSC_KSOFTIRQD_SCHED_PRIORITY
       int 'Scheduler Priority(NORMAL:-20..19, FIFO/RR:1..99)'
       depends on SNSC
       depends on SNSC_KSOFTIRQD_SCHED_OPTION
       default 99

config SNSC_WORKQUEUE_SCHED_OPTION
       bool 'Set scheduler policy/priority for workqueue'
       depends on SNSC
       select SNSC_SET_THREAD_PRIORITY

config SNSC_WORKQUEUE_SCHED_POLICY
       int 'Scheduler Policy(0=NORMAL, 1=FIFO, 2=RR)'
       depends on SNSC
       depends on SNSC_WORKQUEUE_SCHED_OPTION
       default 2

config SNSC_WORKQUEUE_SCHED_PRIORITY
       int 'Scheduler Priority(NORMAL:-20..19, FIFO/RR:1..99)'
       depends on SNSC
       depends on SNSC_WORKQUEUE_SCHED_OPTION
       default 99

config SNSC_NBLARGS
	bool 'Use NBLArgs to pass data from bootloader to kernel'
	depends on SNSC

config SNSC_NBLARGS_RESERVE_ENTRY_REGION
	bool 'Reserve NBLArgs entry region to prevent kernel using that area.'
	depends on SNSC_NBLARGS
	default n
```

## kernel/Kconfig.preempt
```kconfig
config PREEMPT
	bool

config PREEMPT_RT_BASE
	bool
	select PREEMPT

choice
	prompt "Preemption Model"
	default PREEMPT_NONE

config PREEMPT_NONE
	bool "No Forced Preemption (Server)"
	help
	  This is the traditional Linux preemption model, geared towards
	  throughput. It will still provide good latencies most of the
	  time, but there are no guarantees and occasional longer delays
	  are possible.

	  Select this option if you are building a kernel for a server or
	  scientific/computation system, or if you want to maximize the
	  raw processing power of the kernel, irrespective of scheduling
	  latencies.

config PREEMPT_VOLUNTARY
	bool "Voluntary Kernel Preemption (Desktop)"
	help
	  This option reduces the latency of the kernel by adding more
	  "explicit preemption points" to the kernel code. These new
	  preemption points have been selected to reduce the maximum
	  latency of rescheduling, providing faster application reactions,
	  at the cost of slightly lower throughput.

	  This allows reaction to interactive events by allowing a
	  low priority process to voluntarily preempt itself even if it
	  is in kernel mode executing a system call. This allows
	  applications to run more 'smoothly' even when the system is
	  under load.

	  Select this if you are building a kernel for a desktop system.

config PREEMPT_LL
	bool "Preemptible Kernel (Low-Latency Desktop)"
	select PREEMPT
	help
	  This option reduces the latency of the kernel by making
	  all kernel code (that is not executing in a critical section)
	  preemptible.  This allows reaction to interactive events by
	  permitting a low priority process to be preempted involuntarily
	  even if it is in kernel mode executing a system call and would
	  otherwise not be about to reach a natural preemption point.
	  This allows applications to run more 'smoothly' even when the
	  system is under load, at the cost of slightly lower throughput
	  and a slight runtime overhead to kernel code.

	  Select this if you are building a kernel for a desktop or
	  embedded system with latency requirements in the milliseconds
	  range.

config PREEMPT_RTB
	bool "Preemptible Kernel (Basic RT)"
	select PREEMPT_RT_BASE
	help
	  This option is basically the same as (Low-Latency Desktop) but
	  enables changes which are preliminary for the full preemptiple
	  RT kernel.

config PREEMPT_RT_FULL
	bool "Fully Preemptible Kernel (RT)"
	depends on IRQ_FORCED_THREADING
	select PREEMPT_RT_BASE
	help
	  All and everything

endchoice

menu "RT tuning options (NOT IN MAILINE KERNEL)"

config SNSC_RT_OVERLOAD
	int "Real-time process overload floor (2-7)"
	range 2 7
	default "2"
	depends on SMP
	depends on SNSC
	help
	  The number of running real-time processes on a processor that is
	  considered an overload.  When the number of real-time processes in
	  the run queue is equal to or greater than the floor, real-time
	  processes will be pushed to a different processor.

	  Recommended values are 2 (default) or 3 or 4 (for less aggressive
	  migration).  Larger values may result in longer scheduling latencies
	  for real time processes.  Smaller values may result in a real time
	  process less likely to remain on a single processor.

config SNSC_RT_OVERLOAD_HIPRI
	bool "No processes with priority <= MID_USER_RT_PRIO in overload count"
	default y
	depends on PREEMPT_RT_FULL && SMP
	depends on SNSC
	help
	  Do not include processes with a priority <= MID_USER_RT_PRIO in the
	  overload count that the Real-time process overload floor option is
	  checking against.

	  Softirq threads normally have a priority of MID_USER_RT_PRIO.

config SNSC_RT_NO_PUSH_IF_SLEEP
	bool "Do not push RT task if current is about to sleep"
	default n
	depends on SMP
	depends on SNSC
	help
	  If a real-time task is running when another real-time task is woken,
	  the woken task is normally pushed to another processor.  If this
	  option is selected, the woken real-time task is not pushed if the
	  current task is about to sleep (state != TASK_RUNNING).

config SNSC_IRQ_OVERHEAD_ONCE
	bool "Perform IRQ overhead only once for each group of events"
	default n
	depends on PREEMPT_RT_FULL && (ARCH_NE1 || ARCH_EMXX || ARCH_CXD90014BASED)
	depends on SNSC
	depends on !SNSC_ARM_REDUCE_ICACHE_INVALIDATION
	help
	  The normal algorithm for processing interrupts does interrupt
	  pre- and post- processing once for each interrupt.  This option
	  does interrupt pre-processing, then handles all of the interrupts,
	  then does interrupt post-processing.

	  If interrupts arrive in a clump frequently enough then enabling
	  this option will reduce irq disabled latency.

config SNSC_DEBUG_IRQ_OVERHEAD_ONCE
	bool "DEBUG Perform IRQ overhead only once for each group of events"
	default n
	depends on SNSC_IRQ_OVERHEAD_ONCE
	help
	  Add counters to measure behavior of SNSC_IRQ_OVERHEAD_ONCE.  The counters
	  are reported in /proc/interrupts.

endmenu
```
