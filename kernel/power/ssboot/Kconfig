## kernel/power/ssboot/Kconfig
```kconfig
#
# Snapshot Boot related configurations
#

menuconfig SNSC_SSBOOT
	bool "Snapshot Boot support"
	depends on !HIBERNATION
	depends on SNSC
	default n
	select SUSPEND

config SNSC_SSBOOT_DEBUG
	bool "Snapshot Boot debugging support"
	depends on SNSC_SSBOOT
	default n

config SNSC_SSBOOT_DEBUG_SECTION
	bool "Show section information"
	depends on SNSC_SSBOOT_DEBUG
	default n

config SNSC_SSBOOT_PAGE_STAT
	bool "Show page statistics information"
	depends on SNSC_SSBOOT
	default y

config SNSC_SSBOOT_NO_KERNEL
	bool "Exclude kernel R/O sections"
	depends on SNSC_SSBOOT
	default n


config SNSC_SSBOOT_PAGE_ATTR_DUMP
	tristate "Page Attr Dump Writer support"
	depends on SNSC_SSBOOT
	default n

config SNSC_SSBOOT_PAGE_ATTR_DUMP_FILE_NAME
	string "Page Attr Dump Writer filename"
	depends on SNSC_SSBOOT_PAGE_ATTR_DUMP
	default "/tmp/page_attr_dump.txt"

config SNSC_SSBOOT_SBI
	tristate "SBI writer support"
	depends on SNSC_SSBOOT
	default y

config SNSC_SSBOOT_SBI_FILE
	tristate "Generic SBI file writer"
	depends on SNSC_SSBOOT_SBI
	default y

config SNSC_SSBOOT_SBI_FILE_NAME
	string "Default SBI filename"
	depends on SNSC_SSBOOT_SBI_FILE
	default "/ssboot.sbi"

choice
	prompt "Image optimizer"
	default SNSC_SSBOOT_BASIC_OPTIMIZER

config SNSC_SSBOOT_SAMPLE_OPTIMIZER
	tristate "Sample image optimizer support"
	depends on SNSC_SSBOOT

config SNSC_SSBOOT_BASIC_OPTIMIZER
	tristate "Basic image optimizer support"
	depends on SNSC_SSBOOT

endchoice

config SNSC_SSBOOT_BASIC_OPTIMIZER_PROFILE_NAME
	string "Default profiling data file name for basic optimizer"
	depends on SNSC_SSBOOT_BASIC_OPTIMIZER
	default "/ssboot_prof.bin"

config SNSC_SSBOOT_DEBUG_BASIC_OPTIMIZER
       bool "Snapshot Boot debugging support for basic optimizer"
       depends on SNSC_SSBOOT_BASIC_OPTIMIZER
       default n
```

## kernel/time/Kconfig
```kconfig
#
# Timer subsystem related configuration options
#

# Core internal switch. Selected by NO_HZ / HIGH_RES_TIMERS. This is
# only related to the tick functionality. Oneshot clockevent devices
# are supported independ of this.
config TICK_ONESHOT
	bool

config NO_HZ
	bool "Tickless System (Dynamic Ticks)"
	depends on !ARCH_USES_GETTIMEOFFSET && GENERIC_CLOCKEVENTS
	select TICK_ONESHOT
	help
	  This option enables a tickless system: timer interrupts will
	  only trigger on an as-needed basis both when the system is
	  busy and when the system is idle.

config HIGH_RES_TIMERS
	bool "High Resolution Timer Support"
	depends on !ARCH_USES_GETTIMEOFFSET && GENERIC_CLOCKEVENTS
	select TICK_ONESHOT
	help
	  This option enables high resolution timer support. If your
	  hardware is not capable then this option only increases
	  the size of the kernel image.

config GENERIC_CLOCKEVENTS_BUILD
	bool
	default y
	depends on GENERIC_CLOCKEVENTS || GENERIC_CLOCKEVENTS_MIGR

config EJ_LOAD_BALANCE_IN_TIMER_SOFTIRQ
	bool "load balance in timer softirq"
	default n
	depends on EJ_SS_REDUCE_OS_TIMER_LOAD
	depends on EJ_SS_REDUCE_MIGRATION_FREQ

config POSIX_CPU_TIMER
	bool "POSIX cpu timer support"
	default y
```

## lib/Kconfig.debug_snsc
```kconfig
menu "SNSC Configurations"

comment "SNSC debug options"
	depends on SNSC

config SNSC_PRINTK_WATCHDOG
	bool "watchdog to flush output if printk called with IRQs disabled"
	depends on SNSC
	depends on PREEMPT_RT_FULL
	default y
	help
	  For PREEMPT_RT_FULL, when printk() is called with preemption or IRQs
	  disabled the output is buffered, but the console driver is not
	  called.  The buffered output will be printed later when a call to
	  printk() is made with preemption and IRQs enabled.

	  This option creates a watchdog that will periodically check for
	  buffered output and attempt to flush it.

	  The watchdog thread will be created when the watchdog delay time
	  is set to a non-zero value.  The watchdog thread will be terminated
	  when the watchdog delay time is set to zero.  To set the watchdog
	  delay time either specify printk_watchdog_sec=DELAY on the kernel
	  command line or:

	    echo DELAY > /proc/sys/kernel/printk_watchdog_sec

	  where DELAY is an integer number of seconds.

config SNSC_FORCE_RCU_STALL_PRINTK
	bool "force printk to console from RCU stall detection"
	depends on SNSC
	depends on PREEMPT_RT_FULL
	depends on TREE_RCU || TREE_PREEMPT_RCU
	default n
	help
	  THIS FEATURE IS FRAGILE AND SHOULD NOT BE ENABLED ON A PRODUCTION
	  SYSTEM.  Use this feature for testing and debugging only.

	  THIS FEATURE SHOULD BE USED AS A LAST RESORT FOR DEBUGGING.  Try
	  enabling CONFIG_SNSC_PRINTK_WATCHDOG instead.

	  When first trying this feature on a new kernel version or a new
	  platform, it is highly recommended to stress test this feature
	  via the CONFIG_SNSC_DEBUG_PRINT_RCU_STALL option.

	  With CONFIG_PREEMPT_RT_FULL on ARM, output to console from printk()
	  in IRQ context is delayed until a later printk() occurs.  The RCU
	  stall warning printk()s are in IRQ context.  This option will force
	  the printk()s to be flushed to the console immediately in IRQ context.

	  To enable the feature either specify snsc_force_cpu_stall_printk on
	  the kernel command line or:

	    echo 1 > /proc/sys/kernel/snsc_force_rcu_stall_printk

	  To disable the feature:

	    echo 0 > /proc/sys/kernel/snsc_force_rcu_stall_printk

config SNSC_FORCE_SOFTLOCKUP_PRINTK
	bool "force printk to console from watchdog softlockup detection"
	depends on SNSC
	depends on PREEMPT_RT_FULL
	depends on LOCKUP_DETECTOR
	default n
	help
	  THIS FEATURE IS FRAGILE AND SHOULD NOT BE ENABLED ON A PRODUCTION
	  SYSTEM.  Use this feature for testing and debugging only.

	  THIS FEATURE SHOULD BE USED AS A LAST RESORT FOR DEBUGGING.  Try
	  enabling CONFIG_SNSC_PRINTK_WATCHDOG instead.  There are some limits
	  to the printk watchdog (CONFIG_SNSC_PRINTK_WATCHDOG).  The printk
	  watchdog will not trigger if ALL cpus are locked up in IRQ context
	  (such as an infinite loop in an IRQ handler).  The printk watchdog
	  will not trigger if ALL cpus are locked up in processes running at
	  a higher priority than the printk watchdog thread.  This issue can
	  possibly be resolved by changing the scheduling class of the printk
	  watchdog (named "[printkdogd]") to SCHED_RR or SCHED_FIFO and the
	  priority of the printk watchdog to higher than the process that is
	  causing the lockup.  Any timer IRQ thread and timer kernel thread
	  required to wake the printk watchdog also have to have a scheduling
	  class and priority higher than the process that is causing the lockup.

	  Another possible alternative to this feature is
	  CONFIG_BOOTPARAM_SOFTLOCKUP_PANIC, which will cause a panic when
	  the softlockup is detected.  The panic will in turn allow the
	  buffered softlockup messages to print on the console.  However, this
	  may not be a good alternative because it is likely that some of the
	  softlockup messages will have not been printed yet from other cpus,
	  so some information will be lost.

	  When first trying this feature on a new kernel version or a new
	  platform, it is highly recommended to stress test this feature
	  via the CONFIG_SNSC_DEBUG_PRINT_SOFTLOCKUP option.

	  With CONFIG_PREEMPT_RT_FULL on ARM, output to console from printk()
	  in IRQ context is delayed until a later printk() occurs.  The
	  watchdog softlockup warning printk()s are in IRQ context.  This
	  option will force the printk()s to be flushed to the console
	  immediately in IRQ context.

	  To enable the feature either specify snsc_force_softlockup_printk on
	  the kernel command line or:

	    echo 1 > /proc/sys/kernel/snsc_force_softlockup_printk

	  To disable the feature:

	    echo 0 > /proc/sys/kernel/snsc_force_softlockup_printk

endmenu
```

## lib/Kconfig.inst_snsc
```kconfig
comment "SNSC instrumentation options"
	depends on SNSC

config SNSC_PAGES_ACCOUNTING
       default n
       bool "Enable accounting of alloc_pages related"
       depends on SNSC
       help
         This option records alloc_pages activity and reports it via
	 /proc/pages.

config SNSC_PAGES_ACCOUNTING_DEBUG
       bool "show debug info about pages accounting"
       depends on SNSC && SNSC_PAGES_ACCOUNTING
       default n
       help
         If y, print debug message when an orphant dealloc is found
	 by pages accounting.

config SNSC_DEBUG_PROFILE
       bool "Debug/Profiling function support"
       depends on SNSC
       default n
       help
		Writing profile to /proc/profile_record by
		calling profile_record() and profile_record_p().
		Writing a string to /proc/sched_clock
		will be recorded as the string (max 15 chars)
		and the time written.
		So faster than printk with time information.
		Delay is aprox. 20~30ms/100entry(depends on arch).
		To read records, cat /proc/profile_record later.

config SNSC_DEBUG_PROFILE_RECORDS_NUM
	int  "Number of debug profile records"
	default 256
	depends on (SNSC_DEBUG_PROFILE)
	help
		RAM needed: 36bytes/record.
		  9KB for   256 entries.
		 36KB for  1024 entries.
		421KB for 12000 entries.

config SNSC_DEBUG_PROFILE_RINGBUFF
	bool "Debug profile ring buffer mode"
	depends on (SNSC_DEBUG_PROFILE)
	default y
	help
		If this is set to No, write to /proc/profile_record over
		max number of records will be discarded.
		This option will enables wrapping to begining of records
		and overrides old records.

config SNSC_DEBUG_PROFILE_HEAP
	bool "Heap usage profiling support"
	depends on SNSC
	default n
	help
	  Memory usage profile support. The system memory states
	  and the timestamp when kernel calling functions
	  __vm_enough_memory() and try_to_freepages() will be
	  recorded to /proc/profile_heap.

config SNSC_DEBUG_PROFILE_HEAP_RINGBUFF
	bool "Heap profile ring buffer mode"
	depends on SNSC_DEBUG_PROFILE_HEAP
	default y
	help
	  If is set to No, write to /proc/profile_heap over
	  max number of records will be discarded.
	  This option will enables wrapping to begining of records
    	  and overrides old records.

config SNSC_KINSPECT
	bool "Kernel inspect tool"
	depends on SNSC
	depends on MARKERS
	select NETPOLL
	default n

config SNSC_KINSPECT_SURVEY_INTERVAL
	int "Interval time of survey (msec)"
	depends on SNSC
	depends on SNSC_KINSPECT
	default 1000

config SNSC_KINSPECT_INFO_INTERVAL
	int "Interval time of Information output (msec)"
	depends on SNSC
	depends on SNSC_KINSPECT
	default 10000

config SNSC_KINSPECT_KEEPALIVE_INTERVAL
	int "Interval time of keepalive (msec)"
	depends on SNSC
	depends on SNSC_KINSPECT
	default 60000

config SNSC_KINSPECT_MAX_BUF
	hex "buffer size for kernel thread"
	depends on SNSC
	depends on SNSC_KINSPECT
	default 0x8000

config SNSC_KINSPECT_MAX_STORED_BUF
	hex "buffer size without network output"
	depends on SNSC
	depends on SNSC_KINSPECT
	default 0x8000

config SNSC_KINSPECT_DEBUG_MEASURE_MODE
	bool "measuring usage time of kinspect"
	depends on SNSC
	depends on SNSC_KINSPECT
	default n

config SNSC_KINSPECT_KBOOTCHART
	tristate "Kernel Space Bootchart"
	depends on SNSC
	depends on SNSC_KINSPECT

config SNSC_KINSPECT_MEMINFO
	tristate "Kinspect meminfo collector"
	depends on SNSC
	depends on SNSC_KINSPECT

config SNSC_KINSPECT_MEMINFO_BUDDYINFO
	bool "Kinspect meminfo collector output buddyinfo"
	depends on SNSC
	depends on SNSC_KINSPECT_MEMINFO
	default y

config SNSC_KINSPECT_USERLAND_COLLECTOR_MODULE
	tristate "Kinspect userland collector module"
	depends on SNSC
	depends on SNSC_KINSPECT

config SNSC_FREE_MEM_MEASUREMENT
       bool "Print out free memory before starting init process"
       default n

config SNSC_BOOT_TIME
	bool  'Boot time analysis'
	depends on SNSC

choice
	prompt "Boot time version"
	depends on SNSC
	depends on SNSC_BOOT_TIME
	default SNSC_BOOT_TIME_VERSION_2

config SNSC_BOOT_TIME_VERSION_1
	bool "Boot time version 1"
	depends on SNSC_BOOT_TIME
	help
		This version does not support the configurable max comment
	  	length and the ringbuffer.

config SNSC_BOOT_TIME_VERSION_2
	bool "Boot time version 2"
	depends on SNSC_BOOT_TIME
	help
		This version supports the configurable max comment length
		and the ringbuffer.
endchoice

config SNSC_BOOT_TIME_MAX_COMMENT
	int 'Max comment length for boot time'
	depends on SNSC
	depends on SNSC_BOOT_TIME
	depends on SNSC_BOOT_TIME_VERSION_2
	range 24 128
  	default 24
	help
		The value of SNSC_BOOT_TIME_MAX_COMMENT should be
		4bytes aligned.

config SNSC_BOOT_TIME_RINGBUFFER
	bool 'use the boot time ringbuffer mode'
	depends on SNSC
	depends on SNSC_BOOT_TIME
	depends on SNSC_BOOT_TIME_VERSION_2
	default n

config SNSC_BOOT_TIME_USE_NBLARGS
	bool 'Use NBLArgs for boot time save area'
	depends on SNSC
	depends on SNSC_NBLARGS
	depends on SNSC_BOOT_TIME

config SNSC_DEFAULT_BOOT_TIME_BASE
	hex 'Default base addresss of boot time save area'
	depends on SNSC
	depends on SNSC_BOOT_TIME
	default 0x80800000 if ARCH_MX3
	default 0x10800000 if ARCH_OMAP
	default 0x00800000 if ARCH_REALVIEW
	default 0x80800000 if ARCH_NE1
	default 0x40002000 if ARCH_EMXX

config SNSC_DEFAULT_BOOT_TIME_SIZE
	hex 'Default size of boot time save area'
	depends on SNSC
	depends on SNSC_BOOT_TIME
	default 0x2000

config SNSC_BOOT_TIME_IN_USEC
	bool 'print boottime in usec'
	depends on SNSC
	depends on SNSC_BOOT_TIME
	default n
	help
	  Say Y if you want to print boottime is usec format

	  You can also pass "boottime_in_usec" as boot or module load
	  parameter to overwrite this config.

config SNSC_THREAD_RSS
	bool 'Trace thread memory usage'
	depends on SNSC
	default n
	help
	  Say Y here to enable memory usage trace for each thread,
	  including kernel threads and userspace threads.

	  It adds every page allocation/free size to current running
	  thread using "current" pointer. And it does as much as it can
	  to find out whether this allocation/free is really made by
	  current thread or by kernel itself(which is called excluded or
	  unwanted).

	  The results can be read out from a proc interface like:
            $ cat /proc/thread_rss

	  To clear the data:
	    $ echo ANYTHING > /proc/thread_rss

	  If unsure, say N.

config SNSC_THREAD_RSS_HISTORY
	bool 'Save maximum thread memory allocation history'
	depends on SNSC_THREAD_RSS
	default n

config SNSC_PGSCAN
       bool "page scan support"
       depends on SNSC
       default y if ARCH_CXD90014BASED

config SNSC_SET_MIN_FREE_KB
	bool 'Set minimum free memory in KBytes'
	depends on SNSC
	default n
	help
	  Say Y if you want to set minimum free memory in KBytes

	  You can also pass "set_min_free_kb" as boot or module load
	  parameter to overwrite this config
```
